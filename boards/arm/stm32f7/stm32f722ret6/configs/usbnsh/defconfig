## boards/arm/stm32f7/stm32f722ret6/configs/usbnsh/defconfig
```kconfig
CONFIG_ARCH="arm"
CONFIG_ARCH_BOARD_CUSTOM_DIR="/boards/arm/stm32f7/stm32f722ret6"
CONFIG_ARCH_BOARD="stm32f722ret6"
CONFIG_ARCH_BOARD_STM32_F722RET6=y
CONFIG_ARCH_CHIP="stm32f7"
CONFIG_USEC_PER_TICK=1000
CONFIG_ARCH_CHIP_STM32F722RE=y
CONFIG_ARCH_CHIP_STM32F7=y
CONFIG_ARCH_STACKDUMP=y
CONFIG_ARMV7M_DCACHE=y
CONFIG_ARMV7M_DCACHE_WRITETHROUGH=y
CONFIG_ARMV7M_DTCM=y
CONFIG_ARMV7M_ICACHE=y
CONFIG_BOARDCTL_USBDEVCTRL=y
CONFIG_BOARD_LOOPSPERMSEC=43103
CONFIG_BUILTIN=y
CONFIG_DEBUG_SYMBOLS=y
CONFIG_CDCACM=y
CONFIG_CDCACM_CONSOLE=y
CONFIG_DEFAULT_SMALL=y
CONFIG_INIT_ENTRYPOINT="nsh_main"
CONFIG_LINE_MAX=80
CONFIG_NSH_BUILTIN_APPS=y
CONFIG_NSH_FILEIOSIZE=1024
CONFIG_NSH_READLINE=y
CONFIG_RAM_SIZE=245760
CONFIG_RAM_START=0x20010000
CONFIG_RAW_BINARY=y
CONFIG_RR_INTERVAL=200
CONFIG_SCHED_WAITPID=y
CONFIG_START_DAY=5
CONFIG_START_MONTH=7
CONFIG_START_YEAR=2011
CONFIG_STM32_JTAG_FULL_ENABLE=y
CONFIG_STM32_USART1=y
CONFIG_SYMTAB_ORDEREDBYNAME=y
CONFIG_SYSTEM_NSH=y
CONFIG_TASK_NAME_SIZE=0
CONFIG_USBDEV=y
CONFIG_STM32F7_OTGFS=y
CONFIG_BOARDCTL=y
CONFIG_ARCH_LEDS=y
CONFIG_DEV_GPIO=y

CONFIG_SENSORS=y
CONFIG_I2C=y
CONFIG_I2C_DRIVER=y
CONFIG_I2C_RESET=y
CONFIG_STM32F7_I2C1=y
CONFIG_SENSORS_BMP280=y

CONFIG_EXAMPLES_BMP280=y
CONFIG_EXAMPLES_BMP280_PRIORITY=100
CONFIG_EXAMPLES_BMP280_STACKSIZE=2048
CONFIG_EXAMPLES_BMP280_PROGNAME="bmp280"
```
